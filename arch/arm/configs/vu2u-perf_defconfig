## arch/arm/configs/vu2u-perf_defconfig
```kconfig
# CONFIG_ARM_PATCH_PHYS_VIRT is not set
CONFIG_EXPERIMENTAL=y
CONFIG_LOCALVERSION="-perf"
CONFIG_KERNEL_LZO=y
CONFIG_SYSVIPC=y
CONFIG_AUDIT=y
# CONFIG_IKCONFIG is not set
# CONFIG_IKCONFIG_PROC is not set
CONFIG_CGROUPS=y
CONFIG_CGROUP_DEBUG=y
CONFIG_CGROUP_FREEZER=y
CONFIG_CGROUP_CPUACCT=y
CONFIG_RESOURCE_COUNTERS=y
CONFIG_CGROUP_SCHED=y
CONFIG_FAIR_GROUP_SCHED=y
CONFIG_RT_GROUP_SCHED=y
CONFIG_NAMESPACES=y
CONFIG_SYNC=y
CONFIG_SW_SYNC=y
# CONFIG_UTS_NS is not set
# CONFIG_IPC_NS is not set
# CONFIG_USER_NS is not set
# CONFIG_PID_NS is not set
# CONFIG_NET_NS is not set
CONFIG_BLK_DEV_INITRD=y
# CONFIG_RD_BZIP2=y
# CONFIG_RD_LZMA=y
CONFIG_CC_OPTIMIZE_FOR_SIZE=y
CONFIG_PANIC_TIMEOUT=1
CONFIG_KALLSYMS_ALL=y
CONFIG_ASHMEM=y
CONFIG_EMBEDDED=y
CONFIG_PERF_EVENTS=y
# CONFIG_PROFILING=y
# CONFIG_OPROFILE=y
# CONFIG_KPROBES=y
CONFIG_MODULES=y
CONFIG_MODULE_UNLOAD=y
CONFIG_MODULE_FORCE_UNLOAD=y
CONFIG_MODVERSIONS=y
CONFIG_PARTITION_ADVANCED=y
CONFIG_EFI_PARTITION=y
CONFIG_IOSCHED_TEST=n
CONFIG_ARCH_MSM=y
CONFIG_ARCH_MSM8960=y
#CONFIG_ARCH_MSM8930=y
#CONFIG_ARCH_APQ8064=y
CONFIG_MSM_KRAIT_TBB_ABORT_HANDLER=y

CONFIG_KERNEL_MSM_CONTIG_MEM_REGION=y
#
# LGE Machine Selection
#
CONFIG_MACH_LGE=y

#
# LGE Board Selection
#
CONFIG_BOARD_HEADER_FILE="mach/lge/board_vu2u.h"
CONFIG_MACH_MSM8960_VU2=y
CONFIG_MACH_MSM8960_VU2U=y

#
# LGE Specific Patches
#
CONFIG_LGE_CRASH_HANDLER=y
CONFIG_LGE_HIDDEN_RESET=y
CONFIG_LGE_BOOTLOADER_LOG=y
CONFIG_LGE_BNR_RECOVERY_REBOOT=y
CONFIG_LGE_QFPROM_INTERFACE=y
CONFIG_LGE_USES_SMD_DS_TTY=y
CONFIG_LGE_LASTLBA_BACKUPGPT=y
CONFIG_UPDATE_LCDC_LUT=y
CONFIG_LCD_KCAL=y
CONFIG_LGE_KCAL_QLUT=y
CONFIG_LGE_IRRC=y
# CONFIG_MSM_STACKED_MEMORY is not set
CONFIG_KERNEL_PMEM_EBI_REGION=y
# CONFIG_MSM_FIQ_SUPPORT is not set
# CONFIG_MSM_PROC_COMM is not set
CONFIG_MSM_SMD=y
CONFIG_MSM_SMD_PKG4=y
# CONFIG_MSM_PCIE=y
CONFIG_MSM_BAM_DMUX=y
CONFIG_MSM_DSPS=y
CONFIG_MSM_IPC_ROUTER=y
CONFIG_MSM_IPC_ROUTER_SMD_XPRT=y
# CONFIG_MSM_HW3D is not set
CONFIG_MSM_PIL_QDSP6V4=y
# CONFIG_MSM_PIL_RIVA=y
CONFIG_MSM_PIL_TZAPPS=y
CONFIG_MSM_PIL_DSPS=y
CONFIG_MSM_PIL_VIDC=y
CONFIG_MSM_PIL_GSS=y
CONFIG_MSM_SUBSYSTEM_RESTART=y
CONFIG_MSM_MODEM_8960=y
CONFIG_MSM_LPASS_8960=y
#moon-wifi@lge.com by kwisuk.kwon, 20120831
# CONFIG_MSM_WCNSS_SSR_8960 is not set
#CONFIG_MSM_GSS_SSR_8064=y
CONFIG_MSM_TZ_LOG=y
CONFIG_MSM_RPM_LOG=y
CONFIG_MSM_RPM_RBCPR_STATS_LOG=y
CONFIG_MSM_RPM_STATS_LOG=y
CONFIG_MSM_BUS_SCALING=y
CONFIG_MSM_BUS_RPM_MULTI_TIER_ENABLED=y
CONFIG_MSM_WATCHDOG=y
CONFIG_MSM_DLOAD_MODE=y
CONFIG_MSM_SLEEP_STATS=y
CONFIG_MSM_EBI_ERP=y
CONFIG_MSM_CACHE_ERP=y
CONFIG_MSM_L1_ERR_PANIC=y
CONFIG_MSM_L1_ERR_LOG=y
CONFIG_MSM_L2_ERP_2BIT_PANIC=y
CONFIG_MSM_DCVS=y
CONFIG_MSM_HSIC_SYSMON=y
# CONFIG_LGE_COMPRESSED_PATH is not set
# CONFIG_PCI=y
# CONFIG_PCI_MSI=y
CONFIG_NO_HZ=y
CONFIG_HIGH_RES_TIMERS=y
CONFIG_SMP=y
# CONFIG_SMP_ON_UP is not set
CONFIG_PREEMPT=y
CONFIG_AEABI=y
CONFIG_HIGHMEM=y
CONFIG_VMALLOC_RESERVE=0x19000000
CONFIG_LGE_VMALLOC_TOTAL_SIZE=450
CONFIG_COMPACTION=y
CONFIG_CC_STACKPROTECTOR=y
CONFIG_CP_ACCESS=y
CONFIG_CPU_FREQ=y
CONFIG_CPU_FREQ_GOV_PERFORMANCE=y
CONFIG_CPU_FREQ_GOV_POWERSAVE=y
CONFIG_CPU_FREQ_GOV_USERSPACE=y
CONFIG_CPU_FREQ_GOV_ONDEMAND=y
CONFIG_CPU_FREQ_GOV_INTERACTIVE=y
CONFIG_CPU_IDLE=y
CONFIG_VFP=y
CONFIG_NEON=y
# CONFIG_CORE_DUMP_DEFAULT_ELF_HEADERS is not set
CONFIG_WAKELOCK=y
CONFIG_PM_RUNTIME=y
CONFIG_NET=y
CONFIG_PACKET=y
CONFIG_UNIX=y
CONFIG_INET=y

# LGE_CHANGE_S, [LGE_DATA][TCP_Congestion_Control_BIC], y01.jeong@lge.com, 2012-03-05
CONFIG_TCP_CONG_ADVANCED=y
CONFIG_TCP_CONG_CUBIC=y
CONFIG_DEFAULT_TCP_CONG="bic"
CONFIG_DEFAULT_BIC=y
CONFIG_TCP_CONG_BIC=y
# LGE_CHANGE_E, [LGE_DATA][TCP_Congestion_Control_BIC], y01.jeong@lge.com, 2012-03-05

# IWLAND kernel config add [Start] eyes0814@lge.com
CONFIG_IP_ADVANCED_ROUTER=y
CONFIG_IP_MULTIPLE_TABLES=y
# IWLAND kernel config add [End] eyes0814@lge.com
CONFIG_IP_ROUTE_VERBOSE=y
CONFIG_IP_PNP=y
CONFIG_IP_PNP_DHCP=y
# IWLAND kernel config add [Start] eyes0814@lge.com
#LGE_CHANGE_S, [LGE_DATA][VPN_Configuration], taegyu6153.kim@lge.com, 2012-02-08
CONFIG_INET_AH=y
CONFIG_INET_XFRM_TUNNEL=y
#LGE_CHANGE_E, [LGE_DATA][VPN_Configuration], taegyu6153.kim@lge.com, 2012-02-08
#LGE_CHANGE_S, [LGE_DATA][VPN_Configuration], taegyu6153.kim@lge.com, 2012-02-08
CONFIG_INET_XFRM_MODE_TRANSPORT=y
CONFIG_INET_XFRM_MODE_TUNNEL=y
CONFIG_INET_XFRM_MODE_BEET=y
#LGE_CHANGE_E, [LGE_DATA][VPN_Configuration], taegyu6153.kim@lge.com, 2012-02-08
CONFIG_INET_TUNNEL=y
CONFIG_INET_DIAG=y
CONFIG_INET_TCP_DIAG=y
CONFIG_INET6_XFRM_TUNNEL=y
CONFIG_INET6_XFRM_MODE_TRANSPORT=y
CONFIG_INET6_XFRM_MODE_TUNNEL=y
CONFIG_INET6_XFRM_MODE_BEET=y
CONFIG_INET6_TUNNEL=y
CONFIG_IPV6_SIT=y
CONFIG_IPV6_NDISC_NODETYPE=y
CONFIG_ANDROID_PARANOID_NETWORK=y
CONFIG_NET_ACTIVITY_STATS=y
CONFIG_NETFILTER_ADVANCED=y
CONFIG_NETFILTER_NETLINK_QUEUE=y
CONFIG_NF_CONNTRACK_MARK=y
CONFIG_NF_CT_PROTO_GRE=y
CONFIG_NF_CONNTRACK_BROADCAST=y
CONFIG_NETFILTER_XTABLES=y
CONFIG_IP6_NF_TARGET_LOG=y
CONFIG_NF_DEFRAG_IPV6=y

# IWLAND kernel config add [End] eyes0814@lge.com
# CONFIG_INET_LRO is not set
CONFIG_IPV6=y
CONFIG_IPV6_PRIVACY=y
CONFIG_IPV6_ROUTER_PREF=y
CONFIG_IPV6_ROUTE_INFO=y
CONFIG_IPV6_OPTIMISTIC_DAD=y
CONFIG_INET6_AH=y
CONFIG_INET6_ESP=y
CONFIG_INET6_IPCOMP=y
CONFIG_IPV6_MIP6=y
CONFIG_IPV6_MULTIPLE_TABLES=y
CONFIG_IPV6_SUBTREES=y
CONFIG_NETFILTER=y
CONFIG_NETFILTER_NETLINK_LOG=y
CONFIG_NF_CONNTRACK=y
CONFIG_NF_CONNTRACK_EVENTS=y
CONFIG_NF_CT_PROTO_DCCP=y
CONFIG_NF_CT_PROTO_SCTP=y
CONFIG_NF_CT_PROTO_UDPLITE=y
CONFIG_NF_CONNTRACK_AMANDA=y
CONFIG_NF_CONNTRACK_FTP=y
CONFIG_NF_CONNTRACK_H323=y
CONFIG_NF_CONNTRACK_IRC=y
CONFIG_NF_CONNTRACK_NETBIOS_NS=y
CONFIG_NF_CONNTRACK_PPTP=y
CONFIG_NF_CONNTRACK_SANE=y
# CONFIG_NF_CONNTRACK_SIP is not set
CONFIG_NF_CONNTRACK_TFTP=y
CONFIG_NF_CT_NETLINK=y
CONFIG_NETFILTER_TPROXY=y
CONFIG_NETFILTER_XT_TARGET_CLASSIFY=y
CONFIG_NETFILTER_XT_TARGET_CONNMARK=y
CONFIG_NETFILTER_XT_TARGET_LOG=y
CONFIG_NETFILTER_XT_TARGET_MARK=y
CONFIG_NETFILTER_XT_TARGET_NFQUEUE=y
CONFIG_NETFILTER_XT_MATCH_COMMENT=y
CONFIG_NETFILTER_XT_MATCH_CONNLIMIT=y
CONFIG_NETFILTER_XT_MATCH_CONNMARK=y
CONFIG_NETFILTER_XT_MATCH_CONNTRACK=y
CONFIG_NETFILTER_XT_MATCH_HASHLIMIT=y
CONFIG_NETFILTER_XT_MATCH_HELPER=y
CONFIG_NETFILTER_XT_MATCH_IPRANGE=y
CONFIG_NETFILTER_XT_MATCH_LENGTH=y
CONFIG_NETFILTER_XT_MATCH_LIMIT=y
CONFIG_NETFILTER_XT_MATCH_MAC=y
CONFIG_NETFILTER_XT_MATCH_MARK=y
CONFIG_NETFILTER_XT_MATCH_MULTIPORT=y
CONFIG_NETFILTER_XT_MATCH_POLICY=y
CONFIG_NETFILTER_XT_MATCH_PKTTYPE=y
CONFIG_NETFILTER_XT_MATCH_QTAGUID=y
CONFIG_NETFILTER_XT_MATCH_QUOTA=y
CONFIG_NETFILTER_XT_MATCH_QUOTA2=y
CONFIG_NETFILTER_XT_MATCH_QUOTA2_LOG=y
CONFIG_NETFILTER_XT_MATCH_SOCKET=y
CONFIG_NETFILTER_XT_MATCH_STATE=y
CONFIG_NETFILTER_XT_MATCH_STATISTIC=y
CONFIG_NETFILTER_XT_MATCH_STRING=y
CONFIG_NETFILTER_XT_MATCH_TIME=y
CONFIG_NETFILTER_XT_MATCH_U32=y
CONFIG_NF_CONNTRACK_IPV4=y
CONFIG_IP_NF_IPTABLES=y
CONFIG_IP_NF_MATCH_AH=y
CONFIG_IP_NF_MATCH_ECN=y
CONFIG_IP_NF_MATCH_TTL=y
CONFIG_IP_NF_FILTER=y
CONFIG_IP_NF_TARGET_REJECT=y
CONFIG_NF_NAT=y
CONFIG_IP_NF_TARGET_MASQUERADE=y
CONFIG_IP_NF_TARGET_NETMAP=y
CONFIG_IP_NF_TARGET_REDIRECT=y
CONFIG_IP_NF_MANGLE=y
CONFIG_IP_NF_TARGET_CLUSTERIP=y
CONFIG_IP_NF_TARGET_ECN=y
CONFIG_IP_NF_TARGET_TTL=y
CONFIG_IP_NF_RAW=y
CONFIG_IP_NF_ARPTABLES=y
CONFIG_IP_NF_ARPFILTER=y
CONFIG_IP_NF_ARP_MANGLE=y
CONFIG_NF_CONNTRACK_IPV6=y
CONFIG_IP6_NF_QUEUE=y
CONFIG_IP6_NF_IPTABLES=y
CONFIG_IP6_NF_MATCH_AH=y
CONFIG_IP6_NF_MATCH_EUI64=y
CONFIG_IP6_NF_MATCH_FRAG=y
CONFIG_IP6_NF_MATCH_OPTS=y
CONFIG_IP6_NF_MATCH_HL=y
CONFIG_IP6_NF_MATCH_IPV6HEADER=y
CONFIG_IP6_NF_MATCH_MH=y
CONFIG_IP6_NF_MATCH_RPFILTER=y
CONFIG_IP6_NF_MATCH_RT=y
CONFIG_IP6_NF_TARGET_HL=y
CONFIG_IP6_NF_FILTER=y
CONFIG_IP6_NF_TARGET_REJECT=y
CONFIG_IP6_NF_TARGET_REJECT_SKERR=y
CONFIG_IP6_NF_MANGLE=y
CONFIG_IP6_NF_RAW=y
#LGE_CHANGE_S, [LGE_DATA][VPN_Configuration], taegyu6153.kim@lge.com, 2012-02-08
CONFIG_L2TP=y
# CONFIG_L2TP_DEBUGFS is not set
# CONFIG_L2TP_V3 is not set
#LGE_CHANGE_E, [LGE_DATA][VPN_Configuration], taegyu6153.kim@lge.com, 2012-02-08
CONFIG_NET_SCHED=y
CONFIG_NET_SCH_HTB=y
CONFIG_NET_SCH_PRIO=y
CONFIG_NET_CLS_FW=y
CONFIG_NET_CLS_U32=y
CONFIG_CLS_U32_MARK=y
CONFIG_NET_CLS_FLOW=y
CONFIG_NET_EMATCH=y
CONFIG_NET_EMATCH_CMP=y
CONFIG_NET_EMATCH_NBYTE=y
CONFIG_NET_EMATCH_U32=y
CONFIG_NET_EMATCH_META=y
CONFIG_NET_EMATCH_TEXT=y
CONFIG_NET_CLS_ACT=y
CONFIG_BT=y
CONFIG_BT_RFCOMM=y
CONFIG_BT_RFCOMM_TTY=y
CONFIG_BT_BNEP=y
CONFIG_BT_BNEP_MC_FILTER=y
CONFIG_BT_BNEP_PROTO_FILTER=y
CONFIG_BT_HIDP=y
# BRCM_INITIAL_PORTING
# BRCM bluetooth enabled
CONFIG_BT_HCIUART=y
# CONFIG_BT_HCISMD is not set
CONFIG_BT_HCIUART_H4=y
CONFIG_BT_MSM_SLEEP=y
CONFIG_LGE_BLUESLEEP=y
CONFIG_MSM_BT_POWER=n
#moon-wifi@lge.com by kwisuk.kwon, 20120831
#CONFIG_CFG80211=m
# CONFIG_CFG80211_WEXT is not set
CONFIG_RFKILL=y
CONFIG_GENLOCK=y
CONFIG_GENLOCK_MISCDEVICE=y
CONFIG_BLK_DEV_LOOP=y
CONFIG_BLK_DEV_RAM=y
CONFIG_UID_STAT=y
# -- Start -- In fx1sk_skt_rk, GPIO #10 : Audio EARSMART -> VIBRATOR
#CONFIG_PMIC8XXX_VIBRATOR is not set
#CONFIG_LGE_PMIC8XXX_VIBRATOR_VOL is not set
#CONFIG_LGE_PMIC8XXX_VIBRATOR_MIN_TIMEOUT is not set
#CONFIG_LGE_PMIC8XXX_VIBRATOR_OVERDRIVE is not set
CONFIG_ANDROID_VIBRATOR=y
# -- End -- In fx1sk_skt_rk, GPIO #10 : Audio EARSMART -> VIBRATOR
CONFIG_QSEECOM=y
# CONFIG_BU52031NVX is not set
# CONFIG_BU52031NVX_CARKITDETECT is not set
# CONFIG_SCSI=y
# CONFIG_SCSI_TGT=y
# CONFIG_BLK_DEV_SD=y
# CONFIG_CHR_DEV_SG=y
# CONFIG_CHR_DEV_SCH=y
# CONFIG_SCSI_MULTI_LUN=y
# CONFIG_SCSI_CONSTANTS=y
# CONFIG_SCSI_LOGGING=y
# CONFIG_SCSI_SCAN_ASYNC=y
CONFIG_MD=y
CONFIG_BLK_DEV_DM=y
CONFIG_DM_CRYPT=y
CONFIG_NETDEVICES=y
CONFIG_DUMMY=y
#LGE_CHANGE_S, [LGE_DATA][VPN_Configuration], taegyu6153.kim@lge.com, 2012-02-08
CONFIG_TUN=y
#LGE_CHANGE_E, [LGE_DATA][VPN_Configuration], taegyu6153.kim@lge.com, 2012-02-08

CONFIG_NET_VENDOR_BROADCOM=n
# CONFIG_B44 is not set
# CONFIG_NET_CALXEDA_XGMAC is not set
CONFIG_NET_VENDOR_CHELSIO=n
CONFIG_NET_VENDOR_CIRRUS=n
# CONFIG_CS89x0 is not set
# CONFIG_DM9000 is not set
# CONFIG_DNET is not set
CONFIG_NET_VENDOR_FARADAY=n
# CONFIG_FTMAC100 is not set
# CONFIG_FTGMAC100 is not set
CONFIG_NET_VENDOR_INTEL=n
CONFIG_NET_VENDOR_I825XX=n
CONFIG_NET_VENDOR_MARVELL=n
CONFIG_NET_VENDOR_MICREL=n
# CONFIG_KS8851 is not set
# CONFIG_KS8851_MLL is not set
CONFIG_NET_VENDOR_MICROCHIP=n
# CONFIG_ENC28J60 is not set
# CONFIG_MSM_RMNET is not set
CONFIG_MSM_RMNET_BAM=y
CONFIG_MSM_RMNET_SMUX=y
# CONFIG_QFEC is not set
CONFIG_NET_VENDOR_NATSEMI=n
CONFIG_NET_VENDOR_8390=n
# CONFIG_AX88796 is not set
# CONFIG_ETHOC is not set
CONFIG_NET_VENDOR_SEEQ=n
# CONFIG_SEEQ8005 is not set
CONFIG_NET_VENDOR_SMSC=n
# CONFIG_SMC91X is not set
# CONFIG_SMC911X is not set
# CONFIG_SMSC911X is not set
CONFIG_NET_VENDOR_STMICRO=n
# CONFIG_STMMAC_ETH is not set
# CONFIG_PHYLIB is not set

CONFIG_SLIP=y
CONFIG_SLIP_COMPRESSED=y
CONFIG_SLIP_MODE_SLIP6=y
CONFIG_USB_USBNET=n

#LGE_CHANGE_S, [LGE_DATA][VPN_Configuration], taegyu6153.kim@lge.com, 2012-02-08
CONFIG_PPP=y
CONFIG_PPP_MULTILINK=y
CONFIG_PPP_FILTER=y
CONFIG_PPP_ASYNC=y
CONFIG_PPP_SYNC_TTY=y
CONFIG_PPP_DEFLATE=y
CONFIG_PPP_BSDCOMP=y
CONFIG_PPP_MPPE=y
CONFIG_PPPOE=y
CONFIG_PPPOL2TP=y
CONFIG_PPPOLAC=y
CONFIG_PPPOPNS=y
#LGE_CHANGE_E, [LGE_DATA][VPN_Configuration], taegyu6153.kim@lge.com, 2012-02-08
CONFIG_INPUT_EVDEV=y
# CONFIG_INPUT_EVBUG=m
CONFIG_KEYBOARD_ATKBD=n
CONFIG_KEYBOARD_GPIO=y
CONFIG_KEYBOARD_MATRIX=y
CONFIG_KEYBOARD_PMIC8XXX=y
CONFIG_USB=y
CONFIG_INPUT_JOYSTICK=n
# CONFIG_JOYSTICK_XPAD=y
CONFIG_INPUT_TOUCHSCREEN=y
CONFIG_LGE_TOUCHSCREEN_CORE_f200=y
CONFIG_LGE_TOUCH_SYNAPTICS_f200=y
CONFIG_LGE_TOUCH_SYNAPTICS_f200_FW_UPGRADE=y
CONFIG_INPUT_MISC=y
CONFIG_INPUT_PMIC8XXX_PWRKEY=y
CONFIG_INPUT_UINPUT=y
CONFIG_VT=y
CONFIG_CONSOLE_TRANSLATIONS=y
# CONFIG_VT_CONSOLE is not set
CONFIG_VT_CONSOLE_SLEEP=y
CONFIG_HW_CONSOLE=y
# CONFIG_VT_HW_CONSOLE_BINDING is not set
# CONFIG_LEGACY_PTYS is not set
CONFIG_MSM_IPC_LOGGING=y
CONFIG_N_SMUX=y
CONFIG_N_SMUX_LOOPBACK=y
CONFIG_SMUX_CTL=y
CONFIG_SERIAL_MSM_HS=y
CONFIG_SERIAL_MSM_HSL=y
CONFIG_SERIAL_MSM_HSL_CONSOLE=y
CONFIG_DIAG_CHAR=y
#
# LGE DM APP Support
#
CONFIG_LGE_DM_APP=y
CONFIG_LGE_DM_DEV=y
CONFIG_HW_RANDOM=y
CONFIG_HW_RANDOM_MSM=y
CONFIG_I2C=y
CONFIG_I2C_CHARDEV=y
# CONFIG_I2C_MSM is not set
CONFIG_I2C_QUP=y
CONFIG_SPI=y
CONFIG_SPI_QUP=y
# CONFIG_SPI_SPIDEV=m
CONFIG_SLIMBUS_MSM_CTRL=y
CONFIG_DEBUG_GPIO=y
CONFIG_GPIO_SYSFS=y
CONFIG_GPIO_SX150X=y
CONFIG_POWER_SUPPLY=y
# CONFIG_BATTERY_MSM is not set
# CONFIG_ISL9519_CHARGER is not set
# CONFIG_SMB349_CHARGER is not set
CONFIG_PM8921_CHARGER=y
CONFIG_PM8921_BMS=y
CONFIG_LGE_PM=y
CONFIG_LGE_PM_435V_BATT=y
CONFIG_BATTERY_MAX17043=y
CONFIG_LGE_PM_BATTERY_ID_CHECKER=y
CONFIG_LGE_CHARGER_TEMP_SCENARIO=y
CONFIG_LGE_WIRELESS_CHARGER=y
CONFIG_SENSORS_PM8XXX_ADC=y
CONFIG_SENSORS_EPM_ADC=y
CONFIG_THERMAL=y
CONFIG_THERMAL_TSENS8960=y
CONFIG_THERMAL_PM8XXX=y
CONFIG_THERMAL_MONITOR=y
CONFIG_MFD_PM8921_CORE=y
CONFIG_MFD_PM8821_CORE=n
CONFIG_MFD_PM8038_CORE=n
CONFIG_MFD_PM8XXX_SPK=y
CONFIG_MFD_PM8XXX_BATT_ALARM=y
CONFIG_WCD9304_CODEC=n
CONFIG_WCD9310_CODEC=y
CONFIG_REGULATOR_PM8XXX=y
CONFIG_REGULATOR_MSM_GPIO=y
CONFIG_MEDIA_SUPPORT=y
CONFIG_MEDIA_CONTROLLER=y
CONFIG_VIDEO_DEV=y
CONFIG_VIDEO_V4L2_SUBDEV_API=y
CONFIG_MSM_WFD=y
CONFIG_USER_RC_INPUT=n
CONFIG_IR_GPIO_CIR=n

CONFIG_MEDIA_TUNER_CUSTOMISE=y

#
# Customize TV tuners
#
CONFIG_MEDIA_TUNER_SIMPLE=n
CONFIG_MEDIA_TUNER_TDA8290=n
CONFIG_MEDIA_TUNER_TDA827X=n
CONFIG_MEDIA_TUNER_TDA18271=n
CONFIG_MEDIA_TUNER_TDA9887=n
CONFIG_MEDIA_TUNER_TEA5761=n
CONFIG_MEDIA_TUNER_TEA5767=n
CONFIG_MEDIA_TUNER_MT20XX=n
CONFIG_MEDIA_TUNER_MT2060=n
CONFIG_MEDIA_TUNER_MT2063=n
CONFIG_MEDIA_TUNER_MT2266=n
CONFIG_MEDIA_TUNER_MT2131=n
CONFIG_MEDIA_TUNER_QT1010=n
CONFIG_MEDIA_TUNER_XC2028=n
CONFIG_MEDIA_TUNER_XC5000=n
CONFIG_MEDIA_TUNER_XC4000=n
CONFIG_MEDIA_TUNER_MXL5005S=n
CONFIG_MEDIA_TUNER_MXL5007T=n
CONFIG_MEDIA_TUNER_MC44S803=n
CONFIG_MEDIA_TUNER_MAX2165=n
CONFIG_MEDIA_TUNER_TDA18218=n
CONFIG_MEDIA_TUNER_TDA18212=n

CONFIG_VIDEOBUF2_MSM_MEM=y
CONFIG_VIDEO_HELPER_CHIPS_AUTO=n
# CONFIG_USB_VIDEO_CLASS=y
CONFIG_MSM_CAMERA=y
CONFIG_V4L_PLATFORM_DRIVERS=y
CONFIG_MSM_CAMERA_V4L2=y
# CONFIG_IMX074 is not set
# CONFIG_MT9M114 is not set
CONFIG_IMX111=y
CONFIG_IMX111_ACT=y
CONFIG_IMX119=y
CONFIG_MSM_CAMERA_FLASH_LM3559=y
CONFIG_MSM_CAMERA_FLASH=y
CONFIG_MSM_CSI20_HEADER=y
CONFIG_MSM_CAMERA_SENSOR=y
CONFIG_MSM_ACTUATOR=y
CONFIG_MSM_EEPROM=y
CONFIG_MSM_GEMINI=y
# CONFIG_S5K3L1YX=y
# CONFIG_IMX091=y
# CONFIG_RADIO_IRIS=y
# CONFIG_RADIO_IRIS_TRANSPORT=m
CONFIG_ION=y
CONFIG_ION_MSM=y
CONFIG_MSM_KGSL=y
# CONFIG_KGSL_PER_PROCESS_PAGE_TABLE is not set
CONFIG_MSM_KGSL_PAGE_TABLE_COUNT=24
CONFIG_FB=y
CONFIG_FB_VIRTUAL=y
CONFIG_FB_MSM=y
# CONFIG_FB_MSM_BACKLIGHT is not set
CONFIG_FB_MSM_LOGO=y
CONFIG_FB_MSM_TRIPLE_BUFFER=y
CONFIG_FB_MSM_MDP40=y
CONFIG_FB_MSM_OVERLAY=y
CONFIG_FB_MSM_NO_MDP_PIPE_CTRL=y
CONFIG_FB_MSM_OVERLAY0_WRITEBACK=y
CONFIG_FB_MSM_OVERLAY1_WRITEBACK=y
CONFIG_FB_MSM_WRITEBACK_MSM_PANEL=y
CONFIG_FB_MSM_LVDS_MIPI_PANEL_DETECT=y
CONFIG_FB_MSM_HDMI_MSM_PANEL=y
CONFIG_LGE_LCD_UNDERRUN=y
CONFIG_FB_MSM_HDMI_COMMON=y
CONFIG_FB_MSM_MIPI_LGIT_VIDEO_HD_PT_PANEL=y
CONFIG_BACKLIGHT_LCD_SUPPORT=y
CONFIG_LGE_BACKLIGHT_LM3533=y
CONFIG_BACKLIGHT_CLASS_DEVICE=y
CONFIG_MHL_SUPPORT=y
CONFIG_SII8334_MHL_TX=y
CONFIG_LG_MAGIC_MOTION_REMOCON=y
CONFIG_LGE_HDMI_NO_SWITCH_STATE_SET=y
CONFIG_SOUND=y
CONFIG_SND=y
CONFIG_SND_DYNAMIC_MINORS=y
# CONFIG_SND_ARM is not set
# CONFIG_SND_SPI is not set
CONFIG_SND_USB_AUDIO=y
CONFIG_SND_SOC=y
# LGE_BSP_AUDIO, sungsoo.jung@lge.com, 2012-09-12, FX1 voice call rx volume level 10.
CONFIG_LGE_AUDIO_VOICE_CALL_RX_10=y
#
# MSM SoC Audio support
#
CONFIG_SND_SOC_MSM8960=y
CONFIG_LGE_AUDIO=y
#
# Audio driver Selection
#

CONFIG_SND_SOC_TPA2028D=y
CONFIG_SND_SOC_MSM_QDSP6_HDMI_AUDIO=y
#CONFIG_SWITCH_FSA8008=y
# LGE_BSP_AUDIO, jeremy.pi@lge.com, 2012-09-20, Broadcom Bluetooth RF Silicon Audio.
CONFIG_BROADCOM_BT_AUDIO=y

CONFIG_UHID=y
CONFIG_HID_APPLE=y
CONFIG_HID_MAGICMOUSE=y
CONFIG_HID_MICROSOFT=y
CONFIG_USB_ANNOUNCE_NEW_DEVICES=y
CONFIG_USB_SUSPEND=y
CONFIG_USB_EHCI_HCD=y
CONFIG_USB_EHCI_EHSET=y
CONFIG_USB_EHCI_MSM=y
CONFIG_USB_EHCI_MSM_HOST4=y
CONFIG_USB_ACM=y
CONFIG_USB_STORAGE=n

CONFIG_USB_SERIAL=y
# CONFIG_USB_SERIAL_CSVT=y
CONFIG_USB_EHSET_TEST_FIXTURE=y
CONFIG_USB_QCOM_DIAG_BRIDGE=y
CONFIG_USB_QCOM_MDM_BRIDGE=y
CONFIG_USB_QCOM_KS_BRIDGE=y
CONFIG_USB_GADGET=y
CONFIG_USB_GADGET_DEBUG_FILES=y
CONFIG_USB_CI13XXX_MSM=y
CONFIG_USB_G_ANDROID=y
CONFIG_USB_CSW_HACK=n
CONFIG_USB_ANDROID_RMNET_CTRL_SMD=y
CONFIG_USB_ANDROID_CDC_ECM=y
CONFIG_USB_G_LGE_ANDROID_PFSC=y
CONFIG_USB_G_LGE_ANDROID_STORAGE_NAME="Android Platform"
CONFIG_USB_G_LGE_ANDROID_AUTORUN=y
# CONFIG_USB_G_LGE_ANDROID_AUTORUN_VZW is not set
CONFIG_USB_G_LGE_ANDROID_AUTORUN_LGE=y
# CONFIG_USB_G_LGE_ANDROID_VZWLAN is not set
# CONFIG_USB_G_LGE_ANDROID_DTF is not set
CONFIG_USB_G_LGE_ANDROID_CDROM_MAC_SUPPORT=y
CONFIG_MMC=y
CONFIG_MMC_PERF_PROFILING=y
CONFIG_MMC_UNSAFE_RESUME=y
CONFIG_MMC_CLKGATE=y
CONFIG_MMC_PARANOID_SD_INIT=y
CONFIG_MMC_BLOCK_MINORS=32
# CONFIG_MMC_BLOCK_BOUNCE is not set
# CONFIG_MMC_TEST=m
CONFIG_MMC_MSM=y
CONFIG_MMC_MSM_SDC1_8_BIT_SUPPORT=y
# CONFIG_MMC_MSM_SDC2_SUPPORT is not set
CONFIG_MMC_MSM_SDC3_SUPPORT=y
# LGE_UPDATE_START, 2012/08/31, G1-FS@lge.com
# CONFIG_MMC_MSM_SDC3_WP_SUPPORT is not set
# LGE_UPDATE_END
CONFIG_MMC_MSM_SPS_SUPPORT=y
#
# LED drivers
#
CONFIG_LEDS_GPIO=y
CONFIG_LEDS_GPIO_PLATFORM=y
CONFIG_LEDS_PM8XXX=y
CONFIG_LEDS_PM8XXX_RGB=y
CONFIG_LEDS_TRIGGERS=y

#
# LED Triggers
#
CONFIG_LEDS_TRIGGER_TIMER=y
CONFIG_LEDS_TRIGGER_HEARTBEAT=y
CONFIG_LEDS_TRIGGER_BACKLIGHT=y
CONFIG_LEDS_TRIGGER_GPIO=y
CONFIG_LEDS_TRIGGER_DEFAULT_ON=y
CONFIG_LEDS_TRIGGER_SLEEP=y
CONFIG_NFC_DEVICES=y
CONFIG_LGE_NFC=y
CONFIG_LGE_NFC_PN544_C2=y
CONFIG_LGE_NFC_SET_IRQ_WAKEUP=y
CONFIG_LGE_NFC_PRESTANDBY=y
CONFIG_LGE_NFC_MULTICORE_FASTBOOT=y
CONFIG_LGE_NFC_HW_QCT_MSM8960=y
CONFIG_SWITCH=y
CONFIG_SWITCH_FSA8008=y
CONFIG_RTC_CLASS=y
# CONFIG_RTC_DRV_MSM is not set
CONFIG_RTC_DRV_PM8XXX=y
CONFIG_STAGING=y
CONFIG_ANDROID=y
CONFIG_ANDROID_BINDER_IPC=y
CONFIG_ANDROID_LOGGER=y
CONFIG_PERSISTENT_TRACER=y
CONFIG_ANDROID_TIMED_GPIO=y
CONFIG_ANDROID_LOW_MEMORY_KILLER=y
CONFIG_MSM_SSBI=y
CONFIG_SPS=y
CONFIG_SPS_SUPPORT_BAMDMA=y
CONFIG_MSM_AVTIMER=y
CONFIG_MSM_IOMMU=y
CONFIG_MOBICORE_SUPPORT=m
CONFIG_MOBICORE_API=m

#
# LGE Broadcast Device Support
#
CONFIG_LGE_BROADCAST_TDMB=y
CONFIG_LGE_BROADCAST_TDMB_T3900=y


CONFIG_EXT2_FS=y
CONFIG_EXT2_FS_XATTR=y
CONFIG_EXT3_FS=y
# CONFIG_EXT3_DEFAULTS_TO_ORDERED is not set
CONFIG_EXT4_FS=y
CONFIG_EXT4_FS_SECURITY=y
CONFIG_FUSE_FS=y
CONFIG_VFAT_FS=y
CONFIG_TMPFS=y
CONFIG_NFS_FS=y
CONFIG_NFS_V3=y
CONFIG_NFS_V3_ACL=y
CONFIG_NFS_V4=y
CONFIG_ECRYPT_FS=y

CONFIG_NETWORK_FILESYSTEMS=y
CONFIG_CIFS=y
CONFIG_CIFS_XATTR=y
CONFIG_CIFS_POSIX=y
CONFIG_NLS_UTF8=y

CONFIG_NLS_CODEPAGE_437=y
CONFIG_NLS_ASCII=y
CONFIG_NLS_ISO8859_1=y
CONFIG_PRINTK_TIME=y
CONFIG_MAGIC_SYSRQ=y
# CONFIG_SCHED_DEBUG is not set
CONFIG_TIMER_STATS=y
# CONFIG_DEBUG_PREEMPT is not set
CONFIG_DEBUG_INFO=y
CONFIG_DEBUG_MEMORY_INIT=y
CONFIG_DYNAMIC_DEBUG=y
# CONFIG_DEBUG_USER is not set
CONFIG_PID_IN_CONTEXTIDR=y
CONFIG_KEYS=y
CONFIG_ENCRYPTED_KEYS=y
CONFIG_SECURITY=y
CONFIG_SECURITY_NETWORK=y
CONFIG_SECURITY_SELINUX=y
CONFIG_CRYPTO=y
CONFIG_CRYPTO_TWOFISH=y
CONFIG_CRYPTO_DEV_QCRYPTO=m
CONFIG_CRYPTO_DEV_QCE=m
CONFIG_CRYPTO_DEV_QCEDEV=m
CONFIG_CRC_CCITT=y
CONFIG_MSM_DMA_TEST=n
CONFIG_WIFI_CONTROL_FUNC=y
CONFIG_CFG80211=y
CONFIG_BCMDHD=y
CONFIG_BCM4334=y
CONFIG_BCMDHD_FW_PATH="/system/etc/firmware/fw_bcmdhd.bin"
CONFIG_BCMDHD_NVRAM_PATH="/system/etc/wifi/bcmdhd.cal"
CONFIG_LGE_BCM433X_PATCH=y
CONFIG_BCMDHD_CONFIG_PATH="/data/misc/wifi/config"
CONFIG_BCMDHD_GPIO_WL_RESET=82
CONFIG_BCMDHD_HOSTWAKEUP_USE_GPIO=y
CONFIG_BCMDHD_HOSTWAKEUP_USE_SDIO=n
CONFIG_BCMDHD_GPIO_WL_HOSTWAKEUP=81
CONFIG_BCMDHD_HW_OOB=y
#CONFIG_BCMDHD_USE_STATIC_BUF=y
CONFIG_MMC_MSM_SDC4_SUPPORT=y
#moon-wifi@lge.com by kwisuk.kwon, 20121213
CONFIG_BROADCOM_WIFI_RESERVED_MEM=y

# IWLAND kernel config add [Start] eyes0814@lge.com
CONFIG_XFRM=y
#LGE_CHANGE_S, [LGE_DATA][VPN_Configuration], taegyu6153.kim@lge.com, 2012-02-08
CONFIG_XFRM_USER=y
CONFIG_XFRM_SUB_POLICY=y
CONFIG_XFRM_MIGRATE=y
CONFIG_XFRM_STATISTICS=y
CONFIG_NET_KEY=y
# CONFIG_NET_KEY_MIGRATE is not set
#LGE_CHANGE_E, [LGE_DATA][VPN_Configuration], taegyu6153.kim@lge.com, 2012-02-08
CONFIG_INET_ESP=y
CONFIG_INET_IPCOMP=y

CONFIG_CRYPTO_HMAC=y
CONFIG_CRYPTO_XCBC=y
#LGE_CHANGE_S, [LGE_DATA][VPN_Configuration], taegyu6153.kim@lge.com, 2012-02-08
CONFIG_CRYPTO_NULL=y
#LGE_CHANGE_E, [LGE_DATA][VPN_Configuration], taegyu6153.kim@lge.com, 2012-02-08

CONFIG_CRYPTO_MD5=y
CONFIG_CRYPTO_SHA1=y

CONFIG_CRYPTO_DES=y
CONFIG_CRYPTO_AES=y

CONFIG_CRYPTO_DEFLATE=y
# IWLAND kernel config add [End] eyes0814@lge.com

# save cpu and mmu registers to support simulation when debugging
CONFIG_CPU_CP15=y
CONFIG_CPU_CP15_MMU=y


CONFIG_MSM_RTB=y
CONFIG_MSM_RTB_SEPARATE_CPUS=y


#
# Multimedia drivers
#
CONFIG_RC_CORE=n

#
# Input Device Drivers
#
CONFIG_MOUSE_PS2=n


#
# Miscelaneous helper chips
#
CONFIG_V4L_USB_DRIVERS=n
```
