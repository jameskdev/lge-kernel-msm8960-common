## arch/arm/mach-msm/lge/Kconfig
```kconfig
config MACH_LGE
	bool

menu "LGE Board Selection"
source "arch/arm/mach-msm/lge/Kconfig.board"
endmenu


menu "LGE Specific Patches"

config EARJACK_DEBUGGER
	bool "Earjack UART debugger support"
	depends on MACH_APQ8064_MAKO
	default n
	help
	  Saying Y here will support earjack type UART debugger cable

config LGE_CRASH_HANDLER
	tristate "Support LGE Crash Handler"
	depends on !S390 && !UML && HAVE_MEMBLOCK && MSM_DLOAD_MODE
	select ANDROID_PERSISTENT_RAM
	default n
	help
	  LGE Crash Handler

#rename to LGE_CRASH_HANDLER by qct
#config LGE_HANDLE_PANIC
#    tristate "Support LGE Kernel Panic Handler"
#    default n
#    depends on MACH_LGE
#    help
#    LGE Error handler.

config LGE_HIDDEN_RESET
	tristate "LGE hidden reset"
	default n
	depends on MACH_LGE && LGE_CRASH_HANDLER
	help
	  Enables support for LGE hidden reset. For turn on this feature,
	  "echo 1 > /sys/module/lge_handle_panic/parameters/hreset_enable"
	  or "lge_handle_panic.hreset_enable=1" from cmdline.

config LGE_PERSIST_RAM_START
	hex "LGE persistent ram start address"
	depends on ANDROID_PERSISTENT_RAM
	default 0x88700000

config LGE_PERSIST_TRACE_SIZE
	hex "LGE persistent trace buffer size"
	depends on ANDROID_PERSISTENT_TRACER
	default 0x20000

config LGE_BOOTLOADER_LOG
    tristate "Support LGE bootloader log"
    default n
    depends on MACH_LGE
    help
    LGE bootloader log

config LGE_QFPROM_INTERFACE
	bool "Support qfprom interface"
	default n
	depends on MACH_LGE
	help
	  LGE QFPROM DRIVER.

config LGE_LCD_TUNING
     bool "lcd_tuning"
	 default n
	 depends on MACH_LGE
	 help
		Support LCD tuning.

#rename to UPDATE_LCDC_LUT by qct
#config LGE_QC_LCDC_LUT
#     bool "Set initial Qualcomm LCDC lut"
#         default n
#         depends on MACH_LGE
#         help
#	  Set initial Qualcomm LCDC Look Up Table.

config UPDATE_LCDC_LUT
	bool "Set initial Qualcomm LCDC lut"
	default n
	depends on MACH_LGE
	help
	  Set initial Qualcomm LCDC Look Up Table.
	  	  
config LCD_KCAL
	bool "Interface to calibrate LCD color temperature"
	default n
	depends on MACH_LGE && UPDATE_LCDC_LUT
	help
	  Interface to calibrate LCD color temperature

#rename to LCD_KCAL by qct
#config LGE_KCAL
#     bool "Interface to calibrate LCD color temperature"
#         default n
#         depends on MACH_LGE
#         help
#           Interface to calibrate LCD color temperature

	 

config LGE_KCAL_QLUT
     bool "Interface to calibrate LCD color temperature by QLUT"
         default n
         depends on MACH_LGE && UPDATE_LCDC_LUT && LCD_KCAL
         help
                Interface to calibrate LCD color temperature by QLUT

config LGE_USES_SMD_DS_TTY
	bool "Explicitly use smd tty driver for DS"
	default n
	depends on MSM_SMD_TTY && MACH_LGE
	help
		In Qualcomm MSM8960, smd tty driver for ds(/dev/smd0) is not used.
		Say yes if this tty driver must be used on LGE device. This is used
		to connect smd channel in user space(for example, ATCMD processing).

config LGE_SUSPEND_AUTOTEST
    tristate "Test suspend/resume and earlysuspend/lateresume automatically"
    default y
    depends on MACH_LGE && SUSPEND && EARLYSUSPEND
	help
      This option will let you suspend your machine, and make it wake up
	  a few seconds later using an timer automatically.  
	  Enable this with a kernel parameter by sysfs.

config LGE_LOG_SERVICE
	bool "Support LGE log service"
	default y
	depends on MACH_LGE
	help
	  Support LGE log service. The author of this patch is cs77.ha@lge.com

config LGE_LASTLBA_BACKUPGPT
	bool "Force to find Backup GPT at LAST LBA"
	depends on EFI_PARTITION
	help
	  Say Y here if you would like to make kernel always find Backup GPT
	  at Last LBA.
	
config LGE_LH470WX1_NEW
	bool "FX1 new lcd panel"
	default n
	help
	  Select Y here if you are using new panel of fx1.
  
#BEGIN: 0019632 chanha.park@lge.com 2012-05-31
#ADD: 0019632: [F200][BT] Bluetooth board bring-up	  
config LGE_BLUESLEEP
	default y
	bool "MSM8960 LGE Bluetooth LPM"
	depends on MACH_LGE
#END: 0019632 chanha.park@lge.com 2012-05-31

config LGE_LCD_UNDERRUN
bool "lcd_underrun"
   default n
   depends on MACH_LGE
   help
       Show bus clock when underrun occurs.

config LGE_LCD_UNDERRUN
     bool "lcd_underrun"
	 default n
	 depends on MACH_LGE
	 help
		Show bus clock when underrun occurs.

config LGE_BITE_RESET
	tristate "Disable PS_HOLD reset"
	default n
	depends on MACH_LGE
	help
		Reset device by WDT BITE instead of PS_HOLD

config LGE_BNR_RECOVERY_REBOOT
	bool "Support PC suite BNR recovery reboot"
	default y
	depends on MACH_LGE
	help
		Support PC suite BNR recovery reboot. bnr recovery mode
		could be entered with reboot --bnr_recovery cmd.
endmenu
```

## arch/arm/mach-msm/lge/Kconfig.board
```kconfig
#
# Inlcude the specific Kconfig file for LGE board
#
# MAKO
source "arch/arm/mach-msm/lge/mako/Kconfig"

config MACH_LGE_DUMMY
	bool "NONE (No device)"
# D1L
source "arch/arm/mach-msm/lge/d1l/Kconfig"

# D1L_KR
source "arch/arm/mach-msm/lge/d1l_kr/Kconfig"

# L_DCM
source "arch/arm/mach-msm/lge/l_dcm/Kconfig"

# LX(L0/L2/L1)
source "arch/arm/mach-msm/lge/lx/Kconfig"

# FX1(FX1E/FX1A/FX1T/FX1S/FX1V/FX1SU/FX1SK)
source "arch/arm/mach-msm/lge/fx1/Kconfig"

# L1v
source "arch/arm/mach-msm/lge/l1/Kconfig"

# VU2
source "arch/arm/mach-msm/lge/vu2/Kconfig"
```

## arch/arm/mach-msm/lge/d1l/Kconfig
```kconfig
config BOARD_HEADER_FILE
	string "LGE board specific header file name"
	default ""

config MACH_MSM8960_D1L
	depends on ARCH_MSM8960
	select MACH_LGE
	bool "MSM8960 D1L"
	help
	  Support for the LGE MSM8960 D1L device.

choice
	depends on MACH_MSM8960_D1L
	prompt "D1L Board Selection"
	default MACH_MSM8960_D1LV

config MACH_MSM8960_D1LV
	bool "MSM8960 D1L Verizon"
	help
	  Support for the LGE MSM8960 D1L Verizon device.

endchoice
```

## arch/arm/mach-msm/lge/d1l_kr/Kconfig
```kconfig
config MACH_MSM8960_D1L_KR
	depends on ARCH_MSM8960
	select MACH_LGE
	bool "MSM8960 D1L_KR"
	help
	  Support for the LGE MSM8960 D1L device.

choice
	depends on MACH_MSM8960_D1L_KR
	prompt "D1L Board Selection"
	default MACH_MSM8960_D1LSK

config MACH_MSM8960_D1LSK
	bool "MSM8960 D1L SKT"
	help
	  Support for the LGE MSM8960 D1L SKT device.

config MACH_MSM8960_D1LKT
	bool "MSM8960 D1L KT"
	help
	  Support for the LGE MSM8960 D1L KT device.

config MACH_MSM8960_D1LU
	bool "MSM8960 D1L LGU+"
	help
	  Support for the LGE MSM8960 D1L LGU+ device.

endchoice
```

## arch/arm/mach-msm/lge/fx1/Kconfig
```kconfig
config BOARD_HEADER_FILE
	string "LGE board specific header file name"
	default ""

config MACH_MSM8960_FX1
	depends on ARCH_MSM8960
	select MACH_LGE
	bool "MSM8960 FX1"
	help
	  Support for the LGE MSM8960 FX1 device.

choice
	depends on MACH_MSM8960_FX1
	prompt "FX1 Board Selection"
	default MACH_MSM8960_FX1A

config MACH_MSM8960_FX1A
	bool "MSM8960 FX1 AT&T"
	help
	  Support for the LGE MSM8960 FX1 AT&T device.

config MACH_MSM8960_FX1S
	bool "MSM8960 FX1 SPR"
	help
	  Support for the LGE MSM8960 FX1 SRE device.

config LGE_DIAG_USB_ACCESS_LOCK
	tristate "Support LGE diag usb lock command"
	default n
	depends on MACH_MSM8960_FX1S
	help
	  LGE usb access lock

config MACH_MSM8960_FX1E
        bool "MSM8960 FX1 EU"
        help
          Support for the LGE MSM8960 FX1 EU device.

config MACH_MSM8960_FX1T
        bool "MSM8960 FX1T"
        help
          Support for the LGE MSM8960 FX1T device.

config MACH_MSM8960_FX1V
        bool "MSM8960 FX1V"
        help
          Support for the LGE MSM8960 FX1V device.

config MACH_MSM8960_FX1SK
        bool "MSM8960 FX1SK"
        help
          Support for the LGE MSM8960 FX1SK device.
          
config MACH_MSM8960_FX1SU
        bool "MSM8960 FX1SU"
        help
          Support for the LGE MSM8960 FX1SU device.

endchoice
```

## arch/arm/mach-msm/lge/l1/Kconfig
```kconfig
config BOARD_HEADER_FILE
	string "LGE board specific header file name"
	default ""

config MACH_MSM8960_L1
	depends on ARCH_MSM8960
	select MACH_LGE
	bool "MSM8960 L1"
	help
	  Support for the LGE MSM8960 L-PROJECT device.

choice
	depends on MACH_MSM8960_L1
	prompt "L-PROJECT Board Selection"
	default MACH_MSM8960_L1m

config MACH_MSM8960_L1m
	bool "MSM8960 L1m MPCS"
	help
	  Support for the LGE MSM8960 L1m MPCS device.	  

config MACH_MSM8960_L1v
	bool "MSM8960 L1v VZW"
	help
	  Support for the LGE MSM8960 L1v VZW device.	  

endchoice
```

## arch/arm/mach-msm/lge/l_dcm/Kconfig
```kconfig
config MACH_MSM8960_L_DCM
	depends on ARCH_MSM8960
	select MACH_LGE
	bool "MSM8960_L_DCM"
	help
	  Support for the LGE MSM8960 L_DCM device.
```

## arch/arm/mach-msm/lge/lx/Kconfig
```kconfig
config BOARD_HEADER_FILE
	string "LGE board specific header file name"
	default ""

config MACH_MSM8960_LX
	depends on ARCH_MSM8960
	select MACH_LGE
	bool "MSM8960 Lx"
	help
	  Support for the LGE MSM8960 L-PROJECT device.

choice
	depends on MACH_MSM8960_LX
	prompt "L-PROJECT Board Selection"
	default MACH_MSM8960_L0

config MACH_MSM8960_L0
	bool "MSM8960 L0 MPCS"
	help
	  Support for the LGE MSM8960 L0 MPCS device.

config MACH_MSM8960_L2
	bool "MSM8960 L2 SPR"
	help
	  Support for the LGE MSM8960 L2 SPR device.

config MACH_MSM8960_L1A
	bool "MSM8960 L1A ATT"
	help
	  Support for the LGE MSM8960 L1A AT&T device.

config MACH_MSM8960_L1E_EVE_GB
	bool "MSM8960 L1E EVE"
	help
	  Support for the LGE MSM8960 L1E EVE_GB device.
	   
endchoice
```

## arch/arm/mach-msm/lge/vu2/Kconfig
```kconfig
config BOARD_HEADER_FILE
	string "LGE board specific header file name"
	default ""

config MACH_MSM8960_VU2
	depends on ARCH_MSM8960
	select MACH_LGE
	bool "MSM8960 VU2"
	help
	  Support for the LGE MSM8960 VU2 device.

choice
	depends on MACH_MSM8960_VU2
	prompt "VU2 Board Selection"
	default MACH_MSM8960_VU2SK

config MACH_MSM8960_VU2SK
        bool "MSM8960 VU2SK"
        help
          Support for the LGE MSM8960 VU2SK device.
		  
config MACH_MSM8960_VU2KT
        bool "MSM8960 VU2KT"
        help
          Support for the LGE MSM8960 VU2KT device.
          
config MACH_MSM8960_VU2U
        bool "MSM8960 VU2U"
        help
          Support for the LGE MSM8960 VU2U device.

endchoice
```

## drivers/broadcast/Kconfig
```kconfig
# LGE Broadcast Device Driver Support

menu "LGE Broadcast Device Support"


#config LGE_BROADCAST_1SEG
#	bool "1Seg Broadcast service"
#	depends on MACH_MSM8960_L_DCM
#	default y
#	help
#	  Select this if you want to use Japanese 1Seg mobile broadcast service


config LGE_BROADCAST_TDMB
	bool "LGE broadcast TDMB device Driver"
	depends on( MACH_MSM8960_FX1SK || MACH_MSM8960_VU2)
	default y
	help
	  Select this if you want to use TDMB broadcast service

config LGE_BROADCAST_TDMB
	bool "LGE broadcast TDMB device Driver"
	depends on MACH_MSM8960_LX_KR
	default y
	help
	  Select this if you want to use TDMB broadcast service

#source "drivers/broadcast/oneseg/Kconfig"
source "drivers/broadcast/tdmb/Kconfig"
endmenu
```

## drivers/mmc/Kconfig
```kconfig
#
# MMC subsystem configuration
#

menuconfig MMC
	tristate "MMC/SD/SDIO card support"
	depends on HAS_IOMEM
	help
	  This selects MultiMediaCard, Secure Digital and Secure
	  Digital I/O support.

	  If you want MMC/SD/SDIO support, you should say Y here and
	  also to your specific host controller driver.

config MMC_DEBUG
	bool "MMC debugging"
	depends on MMC != n
	help
	  This is an option for use by developers; most people should
	  say N here.  This enables MMC core and driver debugging.

config MMC_PERF_PROFILING
	bool "MMC performance profiling"
	depends on MMC != n
	default n
	help
	  If you say Y here, support will be added for collecting
	  performance numbers at the MMC Queue and Host layers.

# LGE_UPDATE_START
# This is only for D1LV(VS930, Samsung Crappy-eMMC)
# When we use BKOPS, Samsung eMMC is corrupted.
# So, LGE disable BKOPS for only D1LV(VS930)
# 2012-11-15, warkap.seo@lge.com
config LGE_MMC_BKOPS_DISABLE
	bool "Disable eMMC's BKOPS"
	depends on MMC != n
	help
	  If you say Y here, eMMC will not use BKOPS.
# LGE_UPDATE_END

if MMC

source "drivers/mmc/core/Kconfig"

source "drivers/mmc/card/Kconfig"

source "drivers/mmc/host/Kconfig"

endif # MMC
```

## drivers/mmc/core/Kconfig
```kconfig
#
# MMC core configuration
#

config MMC_UNSAFE_RESUME
	bool "Assume MMC/SD cards are non-removable (DANGEROUS)"
	help
	  If you say Y here, the MMC layer will assume that all cards
	  stayed in their respective slots during the suspend. The
	  normal behaviour is to remove them at suspend and
	  redetecting them at resume. Breaking this assumption will
	  in most cases result in data corruption.

	  This option is usually just for embedded systems which use
	  a MMC/SD card for rootfs. Most people should say N here.

	  This option sets a default which can be overridden by the
	  module parameter "removable=0" or "removable=1".

config MMC_CLKGATE
	bool "MMC host clock gating (EXPERIMENTAL)"
	depends on EXPERIMENTAL
	help
	  This will attempt to aggressively gate the clock to the MMC card.
	  This is done to save power due to gating off the logic and bus
	  noise when the MMC card is not in use. Your host driver has to
	  support handling this in order for it to be of any use.

	  If unsure, say N.

config MMC_EMBEDDED_SDIO
	boolean "MMC embedded SDIO device support (EXPERIMENTAL)"
	depends on EXPERIMENTAL
	help
	  If you say Y here, support will be added for embedded SDIO
	  devices which do not contain the necessary enumeration
	  support in hardware to be properly detected.

config MMC_PARANOID_SD_INIT
	bool "Enable paranoid SD card initialization (EXPERIMENTAL)"
	depends on EXPERIMENTAL
	help
	  If you say Y here, the MMC layer will be extra paranoid
	  about re-trying SD init requests. This can be a useful
	  work-around for buggy controllers and hardware. Enable
	  if you are experiencing issues with SD detection.

# LGE_UPDATE_START
# This is only for D1LV(VS930, Samsung Crappy-eMMC)
# When we use ext4-mount-option-discard, Samsung eMMC is corrupted.
# So, Samsung suggest that we use argument(0x00000003)
# 2012-06-28, warkap.seo@lge.com
config LGE_MMC_ERASE_TRIM_ARGU_03
	bool "Enable trim-erase with argument 0x00000003"
	help
	  If you say Y here, trim-erase will be done with argument 0x00000003
# LGE_UPDATE_END
```
